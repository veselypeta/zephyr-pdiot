## CMakeLists.txt
```
# Find Zephyr. This also loads Zephyr's build system.
cmake_minimum_required(VERSION 3.13.1)
find_package(Zephyr)
project(pdiot)

set(CMAKE_CPP_COMPILER g++)
set(BOARD thingy52_nrf52832)

# Add your source file to the "app" target. This must come after
# find_package(Zephyr) which defines the target.
target_sources(app PRIVATE src/main.cpp src/gyro_lite_model.cpp src/neural_network.cpp src/accelerometer.cpp )


# --- TFLITE --- 

zephyr_include_directories(src)


# Set the target and BOARD
set(TARGET ${BOARD})
set(TARGET_ARCH cortex-m4)


set(TF_SRC_DIR  /Users/petrvesely/app/tensorflow)
set(TF_MAKE_DIR ${TF_SRC_DIR}/tensorflow/lite/micro/tools/make)
set(TF_LIB_DIR ${TF_MAKE_DIR}/gen/${TARGET}_${TARGET_ARCH}/lib)
set(extra_project_flags "-mcpu=${TARGET_ARCH} -mthumb -mno-thumb-interwork -mfpu=fpv5-sp-d16")


zephyr_get_include_directories_for_lang_as_string(       C C_includes)
zephyr_get_system_include_directories_for_lang_as_string(C C_system_includes)
zephyr_get_compile_definitions_for_lang_as_string(       C C_definitions)
zephyr_get_compile_options_for_lang_as_string(           C C_options)

set(external_project_cflags
  "${C_includes} ${C_definitions} ${optC_optionsions} ${C_system_includes} ${extra_project_flags}"
)

zephyr_get_include_directories_for_lang_as_string(       CXX CXX_includes)
zephyr_get_system_include_directories_for_lang_as_string(CXX CXX_system_includes)
zephyr_get_compile_definitions_for_lang_as_string(       CXX CXX_definitions)
zephyr_get_compile_options_for_lang_as_string(           CXX CXX_options)

set(external_project_cxxflags
  "${CXX_includes} ${CXX_definitions} ${CXX_options} ${CXX_system_includes} ${extra_project_flags}"
)

include(ExternalProject)


if(CMAKE_GENERATOR STREQUAL "Unix Makefiles")
# https://www.gnu.org/software/make/manual/html_node/MAKE-Variable.html
set(submake "$(MAKE)")
else() # Obviously no MAKEFLAGS. Let's hope a "make" can be found somewhere.
set(submake "make")
endif()


ExternalProject_Add(
  tf_project                 # Name for custom target
  SOURCE_DIR ${TF_SRC_DIR}
  BINARY_DIR ${TF_SRC_DIR} # This particular build system is invoked from the root
  CONFIGURE_COMMAND ""    # Skip configuring the project, e.g. with autoconf
  BUILD_COMMAND ${submake} -f tensorflow/lite/micro/tools/make/Makefile
  TARGET=${TARGET}
  TARGET_ARCH=${TARGET_ARCH}
  TARGET_TOOLCHAIN_ROOT=${GNUARMEMB_TOOLCHAIN_PATH}/bin/
  TARGET_TOOLCHAIN_PREFIX=arm-none-eabi-
  CC=${CMAKE_C_COMPILER}
  CXX=${CMAKE_CXX_COMPILER}
  AR=${CMAKE_AR}
  CCFLAGS=${external_project_cflags} 
  CXXFLAGS=${external_project_cxxflags} 
  microlite
  INSTALL_COMMAND ""      # This particular build system has no install command
  BUILD_BYPRODUCTS ${TF_LIB_DIR}/libtensorflow-microlite.a
  )

# Create a wrapper CMake library that our app can link with
add_library(tf_lib STATIC IMPORTED GLOBAL)

add_dependencies(
  tf_lib
  tf_project
  )
set_target_properties(tf_lib PROPERTIES IMPORTED_LOCATION             ${TF_LIB_DIR}/libtensorflow-microlite.a)
set_target_properties(tf_lib PROPERTIES INTERFACE_INCLUDE_DIRECTORIES "${TF_SRC_DIR};${TF_SRC_DIR}/tensorflow/lite/micro;${TF_MAKE_DIR}/downloads/flatbuffers/include") 

target_link_libraries(app PUBLIC tf_lib)
```

## prj.conf
```kconfig
CONFIG_USE_SEGGER_RTT=y
CONFIG_RTT_CONSOLE=y
CONFIG_UART_CONSOLE=n
CONFIG_CPLUSPLUS=y
CONFIG_NEWLIB_LIBC=y
CONFIG_LIB_CPLUSPLUS=y
CONFIG_NEWLIB_LIBC_FLOAT_PRINTF=y

CONFIG_STDOUT_CONSOLE=y
CONFIG_I2C=y
CONFIG_SENSOR=y
CONFIG_LIS2DH=y


CONFIG_ENTROPY_GENERATOR=y
CONFIG_TEST_RANDOM_GENERATOR=y
CONFIG_BT=y
CONFIG_BT_PERIPHERAL=y
CONFIG_BT_DIS=y
CONFIG_BT_DIS_PNP=n
CONFIG_BT_BAS=y
CONFIG_BT_DEVICE_NAME="ZephyrThingy"
CONFIG_BT_DEVICE_APPEARANCE=1157
```

## src/main.cpp
```c
#include <stdio.h>
#include <zephyr.h>
#include <device.h>
#include <drivers/sensor.h>
#include <logging/log.h>
#include "neural_network.h"
#include "accelerometer.h"
#include "tfservice.h"
#include <bluetooth/conn.h>
#include <bluetooth/bluetooth.h>

LOG_MODULE_REGISTER(main);

void bluetoth_setup()
{
    printf("Starting Bluetooth Setup!");
    bt_conn_cb_register(&conn_callbacks);
    int err = bt_enable(bt_ready);
    if (err)
    {
        printk("Bluetooth init failed (err %d", err);
    }
}

void tflite_send_ble_notif()
{
    if (conn)
    {
        if (notify)
        {
            int err = bt_gatt_notify(NULL, &(stsensor_svc.attrs[1]), &tf_buffer, sizeof(tf_buffer[0]) * tf_buffer_len);
        }
    }
}

void send_ble_accel_packet(AccelerometerData data){
    int x = data.x * 1000;
    int y = data.y * 1000;
    int z = data.z * 1000;

    accel_buffer[0] = x;
    accel_buffer[1] = y;
    accel_buffer[2] = z;


    if (conn){
        if(accNotify){
            int err = bt_gatt_notify(NULL, &(stsensor_svc.attrs[4]), &accel_buffer, sizeof(accel_buffer[0]) * acc_buffer_len);
        }
    }

}

void copy_data_to_ble_buffer(float *preds)
{
    for (int i = 0; i < tf_buffer_len; i++)
    {
        uint16_t val = preds[i] * 1000;
        tf_buffer[i] = val;
    }
}

void main(void)
{
    bluetoth_setup();

    // setup variables for the tflite model
    static float input_tensor_array[50 * 3];
    int counter = 0;

    // setup TFLite Model
    tflite_model_setup();

    // Setup Accelerometer Device
    const struct device *sensor = device_get_binding(DT_LABEL(DT_INST(0, st_lis2dh)));
    if (sensor == NULL)
    {
        printf("Could not get %s device\n",
               DT_LABEL(DT_INST(0, st_lis2dh)));
        return;
    }

    while (true)
    {
        if (counter == 50)
        {
            float *res_buf = tflite_model_predict(input_tensor_array);
            copy_data_to_ble_buffer(res_buf);
            tflite_send_ble_notif();
            counter = 0;
        }
        else
        {

            AccelerometerData acc_data = fetch_data(sensor);
            input_tensor_array[(counter * 3)] = acc_data.x;
            input_tensor_array[(counter * 3) + 1] = acc_data.y;
            input_tensor_array[(counter * 3) + 2] = acc_data.z;

            counter++;
            send_ble_accel_packet(acc_data);

            k_sleep(K_MSEC(80 /*12.5 Hz*/));
        }
    }
}
```

## src/accelerometer.cpp
```c
#include <stdio.h>
#include <zephyr.h>
#include <device.h>
#include <drivers/sensor.h>
#include "accelerometer.h"

AccelerometerData fetch_data(const struct device *sensor)
{
	static unsigned int count;
	struct sensor_value accel[3];
	const char *overrun = "";
	int rc = sensor_sample_fetch(sensor);

	++count;
	if (rc == -EBADMSG)
	{
		/* Sample overrun.  Ignore in polled mode. */
		if (IS_ENABLED(CONFIG_LIS2DH_TRIGGER))
		{
			overrun = "[OVERRUN] ";
		}
		rc = 0;
	}
	if (rc == 0)
	{
		rc = sensor_channel_get(sensor,
								SENSOR_CHAN_ACCEL_XYZ,
								accel);
	}
	if (rc < 0)
	{
		return AccelerometerData({-1, -1, -1});
	}

	double scaler = ((double)SENSOR_G) / 1000000;

	float x = sensor_value_to_double(&accel[0]) / scaler;
	float y = sensor_value_to_double(&accel[1]) / scaler;
	float z = sensor_value_to_double(&accel[2]) / scaler;

	return AccelerometerData({x, y, z});
}
```

## src/accelerometer.h
```c
#pragma once

struct AccelerometerData
{
    float x;
    float y;
    float z;
};

AccelerometerData fetch_data(const struct device *sensor);
```

## src/gyro_lite_model.h
```c
#pragma once


extern const unsigned char gyroscope_model_1_layer_small_tflite[];
extern const unsigned int gyroscope_model_1_layer_small_tflite_len;
```

## src/neural_network.cpp
```c
#include "tensorflow/lite/micro/all_ops_resolver.h"
#include "tensorflow/lite/micro/micro_error_reporter.h"
#include "tensorflow/lite/micro/micro_interpreter.h"
#include "tensorflow/lite/schema/schema_generated.h"
#include "tensorflow/lite/version.h"
#include "gyro_lite_model.h"

// Globals, used for compatibility with Arduino-style sketches.
namespace
{
    tflite::ErrorReporter *error_reporter = nullptr;
    const tflite::Model *model = nullptr;
    tflite::MicroInterpreter *interpreter = nullptr;
    TfLiteTensor *input = nullptr;
    TfLiteTensor *output = nullptr;
    int inference_count = 0;

    // Create an area of memory to use for input, output, and intermediate arrays.
    // Minimum arena size, at the time of writing. After allocating tensors
    // you can retrieve this value by invoking interpreter.arena_used_bytes().
    // TODO - try and reduce
    const int kTensorArenaSize = 30 * 1024;
    uint8_t tensor_arena[kTensorArenaSize];
} // namespace

void tflite_model_setup()
{

    static tflite::MicroErrorReporter micro_error_reporter;
    error_reporter = &micro_error_reporter;

    model = tflite::GetModel(gyroscope_model_1_layer_small_tflite);
    if (model->version() != TFLITE_SCHEMA_VERSION)
    {
        TF_LITE_REPORT_ERROR(error_reporter,
                             "model provided is schema version %d not equal to supported version %d",
                             model->version(),
                             TFLITE_SCHEMA_VERSION);
        return;
    }

    // Setup Resolver
    static tflite::MicroMutableOpResolver<10> resolver;
    resolver.AddConv2D();
    resolver.AddMaxPool2D();
    resolver.AddFullyConnected();
    resolver.AddSoftmax();
    resolver.AddRelu();
    resolver.AddAdd();
    resolver.AddReshape();

    static tflite::MicroInterpreter static_interpreter(
        model, resolver, tensor_arena, kTensorArenaSize, error_reporter);
    interpreter = &static_interpreter;

    TfLiteStatus allocate_status = interpreter->AllocateTensors();
    if (allocate_status != kTfLiteOk)
    {
        TF_LITE_REPORT_ERROR(error_reporter, "AllocateTensors() failed");
        return;
    }

    input = interpreter->input(0);
    output = interpreter->output(0);

    inference_count = 0;
}

float *tflite_model_predict(float *buffer)
{

    // place input into input tensor
    float *x = interpreter->typed_input_tensor<float>(0);
    memcpy(x, buffer, 150);

    // Run inference, and report any error
    TfLiteStatus invoke_status = interpreter->Invoke();
    if (invoke_status != kTfLiteOk)
    {
        TF_LITE_REPORT_ERROR(error_reporter,
                             "INVOKE failed on interpreter");
        return NULL;
    }

    float *y = interpreter->typed_output_tensor<float>(0);

    printf("----- OUTPUT ----- \n");
    printf("%f , %f , %f , total=%f\n", y[0], y[1], y[2], y[0] + y[1] + y[2]);

    return y;
}
```

## src/neural_network.h
```c
#pragma once
#include "tensorflow/lite/micro/micro_interpreter.h"
void tflite_model_setup();

float* tflite_model_predict(float *buffer);
```

## src/tfservice.h
```c
#pragma once

#include <string>
#include <bluetooth/bluetooth.h>
#include <bluetooth/hci.h>
#include <bluetooth/conn.h>
#include <bluetooth/uuid.h>
#include <bluetooth/gatt.h>
#include <bluetooth/services/bas.h>
#include <bluetooth/services/hrs.h>

/* Device and advertising parameters */
#define DEVICE_NAME CONFIG_BT_DEVICE_NAME
#define DEVICE_NAME_LEN (sizeof(DEVICE_NAME) - 1)
#define ADV_LEN 12

/* BLE connection */
struct bt_conn *conn;

/* BLE data params */
static uint8 tf_buffer_len = 3;
static uint16_t tf_buffer[] = {1000, 2000, 3000};

static uint8 acc_buffer_len = 3;
static int accel_buffer[] = {10, 11, 12};

static bool notify = false;
static bool accNotify = false;

/* TF Custom Service  -- initialise a GUID */
static struct bt_uuid_128 tf_service_uuid = BT_UUID_INIT_128(
    0x8f, 0xe5, 0xb3, 0xd5, 0x2e, 0x7f, 0x4a, 0x98,
    0x2a, 0x48, 0x7a, 0xcc, 0x40, 0xfe, 0x00, 0x00);

/* TF Probabilities characteristic UUID */
static struct bt_uuid_128 tf_prob_char_id = BT_UUID_INIT_128(
    0x19, 0xed, 0x82, 0xae, 0xed, 0x21, 0x4c, 0x9d,
    0x41, 0x45, 0x22, 0x8e, 0x41, 0xfe, 0x00, 0x00);

static struct bt_uuid_128 acc_char_id = BT_UUID_INIT_128(
    0x19, 0xed, 0x82, 0xae, 0xed, 0x21, 0x4c, 0x9d,
    0x41, 0x45, 0x22, 0x8e, 0x42, 0xfe, 0x00, 0x00);

/* Advertising data */
static uint8_t manuf_data[ADV_LEN] = {
    0x01 /*SKD version */,
    0x83 /* STM32WB - P2P Server 1 */,
    0x00 /* GROUP A Feature  */,
    0x00 /* GROUP A Feature */,
    0x00 /* GROUP B Feature */,
    0x00 /* GROUP B Feature */,
    0x00, /* BLE MAC start -MSB */
    0x00,
    0x00,
    0x00,
    0x00,
    0x00, /* BLE MAC stop */
};

static const struct bt_data ad[] = {
    BT_DATA_BYTES(BT_DATA_FLAGS, (BT_LE_AD_GENERAL | BT_LE_AD_NO_BREDR)),
    BT_DATA(BT_DATA_NAME_COMPLETE, DEVICE_NAME, DEVICE_NAME_LEN),
    BT_DATA(BT_DATA_MANUFACTURER_DATA, manuf_data, ADV_LEN)};

static void mpu_ccc_cfg_changed(const struct bt_gatt_attr *attr, uint16_t value)
{
    ARG_UNUSED(attr);
    notify = value == 1 ? true : false;
    printk("Notifications set to = %d", notify);
}

static void acc_ccc_cfg_changed(const struct bt_gatt_attr *attr, uint16_t value)
{
    ARG_UNUSED(attr);
    accNotify = value == 1 ? true : false;
    printk("Notification set to %d", accNotify);
}

static ssize_t read_tflite(struct bt_conn *conn,
                           const struct bt_gatt_attr *attr, void *buf,
                           uint16_t len, uint16_t offset)
{

    uint16_t *value = (uint16_t *)attr->user_data;
    printk("Read callback called with: value %d, len %d, offset %d \n", value, len, offset);

    return bt_gatt_attr_read(conn, attr, buf, len, offset, value,
                             sizeof(*value) * 3);
}

static ssize_t read_accel(struct bt_conn *conn,
                          const struct bt_gatt_attr *attr, void *buf,
                          uint16_t len, uint16_t offset)
{

    int *value = (int *)attr->user_data;
    printk("Read callback called with: value %d, len %d, offset %d \n", value, len, offset);

    return bt_gatt_attr_read(conn, attr, buf, len, offset, value,
                             sizeof(*value) * 3);
}

BT_GATT_SERVICE_DEFINE(stsensor_svc,
                       BT_GATT_PRIMARY_SERVICE(&tf_service_uuid),
                       BT_GATT_CHARACTERISTIC(
                           &tf_prob_char_id.uuid,
                           BT_GATT_CHRC_READ | BT_GATT_CHRC_NOTIFY,
                           BT_GATT_PERM_READ,
                           read_tflite,
                           NULL,
                           &tf_buffer),
                       BT_GATT_CCC(mpu_ccc_cfg_changed, BT_GATT_PERM_READ | BT_GATT_PERM_WRITE),
                       BT_GATT_CHARACTERISTIC(
                           &acc_char_id.uuid,
                           BT_GATT_CHRC_NOTIFY | BT_GATT_CHRC_READ,
                           BT_GATT_PERM_READ,
                           read_accel,
                           NULL,
                           &accel_buffer),
                       BT_GATT_CCC(acc_ccc_cfg_changed, BT_GATT_PERM_READ | BT_GATT_PERM_WRITE));

/* Function which starts advertising */
static void bt_ready(int err)
{
    if (err)
    {
        printk("Bluetooth init failed (err %d)", err);
        return;
    }
    printk("Bluetoth Initialised!");
    /* Manually create advertising params - MACRO FAILS C++ */
    struct bt_le_adv_param my_param = {
        .id = BT_ID_DEFAULT,
        .sid = 0,
        .options = BT_LE_ADV_OPT_CONNECTABLE,
        .interval_min = BT_GAP_ADV_FAST_INT_MIN_2,
        .interval_max = BT_GAP_ADV_FAST_INT_MAX_2,
        .peer = NULL,
    };
    /* Start Advertising */
    err = bt_le_adv_start(
        &my_param,
        ad,
        ARRAY_SIZE(ad),
        NULL,
        0);
    if (err)
    {
        printk("Advertising failed to start (err %d)", err);
        return;
    }
    printk("Advertising Started : Waiting For Connections");
}

/* Define Connected and Disconnected Callback */

static void connected(struct bt_conn *connected, uint8_t err)
{
    if (err)
    {
        printk("Connection failed (err %u)", err);
    }
    else
    {
        printk("Connected");
        if (!conn)
        {
            conn = bt_conn_ref(connected);
        }
    }
}

static void disconnected(struct bt_conn *disconn, uint8_t reason)
{
    if (conn)
    {
        bt_conn_unref(conn);
        conn = NULL;
    }

    printk("Disconnected (reason %u)", reason);
}

static struct bt_conn_cb conn_callbacks = {
    .connected = connected,
    .disconnected = disconnected,
};
```
